/ {
    chosen {
        zmk,kscan = &kscan0;
    };
};

&kscan0 {
    label = "john_numpad";
    diode-direction = "col2row";

    // R0..R3
    row-gpios = <&gpio0 6 GPIO_ACTIVE_HIGH>,
                <&gpio0 8 GPIO_ACTIVE_HIGH>,
                <&gpio0 10 GPIO_ACTIVE_HIGH>,
                <&gpio0 11 GPIO_ACTIVE_HIGH>;

    // C0..C2
    col-gpios = <&gpio0 2 GPIO_ACTIVE_HIGH>,
                <&gpio0 3 GPIO_ACTIVE_HIGH>,
                <&gpio0 4 GPIO_ACTIVE_HIGH>;
};
