/ {
    chosen {
        zmk,kscan = &kscan0;
    };
};

&kscan0 {
    label = "john_numpad";
    /* Diodes from columns -> rows */
    diode-direction = "col2row";

    /* R0..R4 (top to bottom) */
    row-gpios = <&gpio0 6  GPIO_ACTIVE_HIGH>,   /* P0.06 */
                <&gpio0 8  GPIO_ACTIVE_HIGH>,   /* P0.08 */
                <&gpio0 10 GPIO_ACTIVE_HIGH>,   /* P0.10 */
                <&gpio0 11 GPIO_ACTIVE_HIGH>,   /* P0.11 */
                <&gpio0 9  GPIO_ACTIVE_HIGH>;   /* P0.09 */

    /* C0..C3 (left to right) */
    col-gpios = <&gpio0 2  GPIO_ACTIVE_HIGH>,   /* P0.02 */
                <&gpio0 29 GPIO_ACTIVE_HIGH>,   /* P0.29 */
                <&gpio0 31 GPIO_ACTIVE_HIGH>,   /* P0.31 */
                <&gpio1 15 GPIO_ACTIVE_HIGH>;   /* P1.15 */
};
